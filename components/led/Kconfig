## components/led/Kconfig
```kconfig
menu "Status LED"

config DL_LED_GPIO
    int "WS2812 data GPIO"
    default 48
    range 0 48
    help
        The YD-ESP32-S3 / DevKitC-1 layout puts the onboard pixel on GPIO48.
        Some clone revisions ship with the RGB solder jumper open; if the
        LED stays dark on a fresh board, bridge it before suspecting code.

choice DL_LED_ORDER
    prompt "WS2812 colour order"
    default DL_LED_ORDER_GRB

config DL_LED_ORDER_GRB
    bool "GRB (ordinary WS2812B, most clone boards)"

config DL_LED_ORDER_RGB
    bool "RGB (Espressif DevKitC-1 onboard pixel)"

endchoice

config DL_LED_BRIGHTNESS
    int "Brightness (%)"
    default 15
    range 1 100
    help
        The SuperMini's pixel sits bare on the board and is glaring at
        full drive; 15% reads clearly across a room.

endmenu
```

## components/netlink/Kconfig
```kconfig
menu "Network link (WiFi station)"

config NETLINK_SSID0
    string "Seed WiFi SSID"
    default ""
    help
        First entry of the NVS credential table, written on first boot if
        the table is empty. Leave blank in committed defaults.

config NETLINK_PASS0
    string "Seed WiFi password"
    default ""


config NETLINK_MAX_CREDS
    int "Credential table size"
    default 8
    range 1 16
    help
        How many SSID/password pairs NVS holds. Eight covers a home
        network, a bench network and a few moves.

config NETLINK_ROAM_RSSI
    int "Roam-check threshold (dBm)"
    default -70
    range -95 -40
    help
        Below this the driver raises WIFI_EVENT_STA_BSS_RSSI_LOW and the
        station scans for a better AP on the same SSID. Inherited from
        relo-bridge, where beacon timeouts began around -75 dBm.

config NETLINK_MAX_BACKOFF_MS
    int "Reconnect backoff ceiling (ms)"
    default 30000
    range 1000 300000

config NETLINK_JOIN_TIMEOUT_MS
    int "Time allowed from associate to IP (ms)"
    default 15000
    range 3000 60000
    help
        An association that never yields an address (wrong VLAN, DHCP
        exhausted) is a failure for that credential this cycle, so the
        station moves to the next one instead of sitting on a dead link.

endmenu
```

## components/provision/Kconfig
```kconfig
menu "Provisioning portal"

config PROVISION_AUTO_S
    int "Start the portal after this long with no known network (s)"
    default 90
    range 0 3600
    help
        A station moved to a site whose SSID is not in its table would
        otherwise sit red forever. 0 disables the automatic trigger; the
        BOOT button and the console still work.

config PROVISION_TIMEOUT_S
    int "Close after this long with nobody on the portal (s)"
    default 1800

config PROVISION_IDLE_S
    int "Close when a connected client has been idle this long (s)"
    default 300
    help
        Association alone does not keep the portal open: a phone that
        joined the open network and was put down would otherwise hold the
        station off the fleet network. Only page requests count.

config PROVISION_MAX_S
    int "Hard cap on a portal session (s)"
    default 3600

endmenu
```

## components/updater/Kconfig
```kconfig
menu "Updates (OTA)"

config DL_OTA_MANIFEST_URL
    string "Manifest URL"
    default "https://github.com/slastra/downlink/releases/latest/download/manifest.json"
    help
        Where boards look for new releases. GitHub redirects "latest" to the
        newest non-prerelease, so publishing a release is the whole rollout.
        Overridable per check over MQTT ({"cmd":"ota.check","manifest":...}).

config DL_OTA_CHECK_H
    int "Hours between checks"
    default 6
    range 1 168
    help
        A check only reports what is available (status "ota.available"); an
        install needs {"cmd":"ota"}. The first check is a minute after the
        broker first connects; a failed one is retried after 30 minutes.

config DL_OTA_CONFIRM_MIN
    int "Minutes for a new image to reach the broker"
    default 10
    range 1 120
    help
        A new image must reach the broker within this long after boot, or the
        board rolls back to the previous one. Reaching the broker is what
        proves it can still be managed (and updated again).

config DL_OTA_PAUSE_MS
    int "Pause after each 4 KB written (ms)"
    default 10
    range 0 200
    help
        Each flash sector erase stalls both cores and PSRAM for tens of ms.
        The music is faded out for the download (the stalls chop it up
        audibly even when the output never underruns), so this only leaves
        the other tasks (WiFi, MQTT, the player) room between erases.
        0 writes flat out.

endmenu
```

## components/uplink/Kconfig
```kconfig
menu "Uplink (MQTT)"

config UPLINK_URI
    string "MQTT broker URI (seed)"
    default ""
    help
        mqtt://host:port. Like the WiFi seed, copied into NVS ("mqtt") on
        first boot; after that NVS is the truth, so release images built
        without credentials keep the ones a board already has. Empty with
        nothing in NVS leaves MQTT off.

config UPLINK_USER
    string "MQTT username (seed)"
    default ""

config UPLINK_PASS
    string "MQTT password (seed)"
    default ""

config UPLINK_TOPIC_ROOT
    string "Topic root"
    default "downlink"
    help
        Topics are <root>/<device id>/status (retained), .../cmd and
        .../cmd/result.

config UPLINK_QUEUE_DEPTH
    int "Outbound publish queue depth"
    default 8

config UPLINK_WILL_DELAY_S
    int "Will delay (s)"
    default 5
    help
        MQTT 5 will delay: a WiFi roam shorter than this never shows as
        offline on the retained status topic.

config UPLINK_CONNECT_TIMEOUT_S
    int "Broker connect watchdog (s)"
    default 30
    help
        Past this without a broker (with an IP) the client is forced to
        reconnect instead of sitting quietly offline.

endmenu
```

## main/Kconfig.projbuild
```kconfig
menu "downlink"

config DL_DEVICE_ID
    string "Device id"
    default "downlink"
    help
        DHCP hostname, the portal AP's suffix ("downlink-<id>") and the MQTT
        topic segment (downlink/<id>/...). Give each board its own.
        Overridable from the portal; NVS wins over this.

config DL_BOARD
    string "Board name"
    default "n16r8"
    help
        Reported in the MQTT status, and how OTA will pick the right image
        for this board.

config DL_STREAM_URL
    string "Stream URL"
    default "http://icecast.example:8000/stream"
    help
        Icecast mount serving Ogg Opus (RUMP with codec = Opus). A seed:
        copied to NVS on first boot (unless it is the placeholder), then
        changed by the portal or the MQTT "url" command.

menu "I2S (PCM5102A)"

config DL_I2S_BCK_GPIO
    int "BCK GPIO"
    default 4
    range 0 48

config DL_I2S_WS_GPIO
    int "LRCK / WS GPIO"
    default 5
    range 0 48

config DL_I2S_DOUT_GPIO
    int "DIN (data out) GPIO"
    default 6
    range 0 48

endmenu

config DL_VOLUME
    int "Volume (0-100)"
    default 70
    range 0 100
    help
        Digital gain before the DAC. 100 is unity; each step below is
        0.5 dB, so 70 is -15 dB and 0 is silence. The PCM5102A has no
        hardware volume. A default: the MQTT "volume" command changes it
        live and saves it to NVS, which wins from then on.

config DL_RING_KB
    int "Stream ring buffer (KB, PSRAM)"
    default 512
    range 64 4096
    help
        Compressed bytes between the network and the decoder. 512 KB is
        about 30 s of 128 kbps Opus: it absorbs Icecast's connect burst
        and rides out a short WiFi drop.

config DL_PREBUFFER_MS
    int "Prebuffer before playback (ms of audio)"
    default 2000
    range 250 30000
    help
        Playback starts (and restarts after an underrun) once this much
        audio is buffered. Measured in audio from the Ogg granule
        positions, not bytes: Opus is variable-bitrate, and a quiet passage
        is ~40x smaller than a loud one.

config DL_BUFFER_MS
    int "Buffer depth to hold (ms of audio)"
    default 4000
    range 500 60000
    help
        The depth the drift correction holds against the difference between
        the source's clock and this board's. Icecast's connect burst usually
        lands near this on its own; deeper rides out longer network
        stalls, shallower is closer to live.

config DL_BUFFER_MAX_MS
    int "Catch up above (ms of audio)"
    default 12000
    range 2000 300000
    help
        Above this depth the player decodes and discards until it is back
        at DL_BUFFER_MS. Joining an Icecast mount during a silent passage
        can hand over minutes of audio in one byte-sized burst.

menu "Announcements"

config DL_ANNOUNCE_QUEUE
    int "Announcements queued at once (fetching, ready and playing)"
    default 4
    range 1 16

config DL_ANNOUNCE_MAX_KB
    int "Largest clip (KB)"
    default 512
    range 16 4096
    help
        A larger clip fails with "too large". At 48 kbps, 512 KB is about
        85 s. Must not exceed the budget below.

config DL_ANNOUNCE_BUDGET_KB
    int "PSRAM for queued clips (KB)"
    default 2048
    range 64 8192
    help
        All downloaded clips together. A fetch that would exceed it waits
        for a clip ahead to finish. The SuperMini (2 MB PSRAM) uses 768.

config DL_DUCK_ATTACK_MS
    int "Duck: music down over (ms)"
    default 300
    range 10 5000

config DL_DUCK_TAIL_MS
    int "Duck: hold after the clip (ms)"
    default 150
    range 0 5000

config DL_DUCK_RELEASE_MS
    int "Duck: music back up over (ms)"
    default 700
    range 10 10000

endmenu

config DL_STALL_S
    int "Reconnect when no stream data for (s)"
    default 10
    range 3 120

config DL_MAX_BACKOFF_S
    int "Stream reconnect backoff ceiling (s)"
    default 30
    range 2 600

endmenu
```
